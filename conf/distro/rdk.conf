## conf/distro/rdk.conf
```bitbake
#
# Distribution definition for: rdk
#
DISTRO = "rdk"
DISTRO_NAME = "RDK (A Yocto Project based Distro)"
DISTRO_VERSION = "7.0"
DISTRO_CODENAME = "kirkstone"

MAINTAINER ?= "RDK Support <support@rdkcentral.com>"

## Enable to limit the CPU load on a CI system.
#PARALLEL_MAKE:append = " -l ${@int(os.sysconf(os.sysconf_names['SC_NPROCESSORS_ONLN'])) * 150/100}"

# Add DISTRO_CODENAME to the list of OVERRIDES that bitbake checks when parsing
# overrides in recipes, similar to hybrid, mediaclient, broadband.
OVERRIDES .= ":${DISTRO_CODENAME}"

# Historically (ie in OE 1.6 builds) BB_DANGLINGAPPENDS_WARNONLY has been set
# indirectly via meta-linaro and meta-linaro-toolchain layer.conf files. Since
# RDK builds rely on it heavily (there are typically many dangling .bbappends)
# define explicitly to avoid hidden dependencies on the Linaro meta layers.
BB_DANGLINGAPPENDS_WARNONLY = "true"
```

## conf/layer.conf
```bitbake
# We have a conf and classes directory, add to BBPATH
BBPATH .= ":${LAYERDIR}"

BBFILE_COLLECTIONS += "middleware-release"
BBFILE_PATTERN_middleware-release = "^${LAYERDIR}/"
BBFILE_PRIORITY_middleware-release = "6"

LAYERDEPENDS_middleware-release = "core"
LAYERSERIES_COMPAT_middleware-release = "kirkstone"
```
